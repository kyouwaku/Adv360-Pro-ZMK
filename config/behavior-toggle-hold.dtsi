/ {
    behaviors {
        toggle_hold: behavior_toggle_hold {
            compatible = "zmk,behavior-hold-tap";
            label = "TOGGLE_HOLD";
            #binding-cells = <2>;
            tapping-term-ms = <200>;
            flavor = "tap-preferred";
            bindings = <&mo 0 &tog 1>;
        };
    };
};
